## meta-layerindex-othertest/conf/layer.conf
```bitbake
# We have a conf and classes directory, add to BBPATH
BBPATH .= ":${LAYERDIR}"

# We have recipes-* directories, add to BBFILES
BBFILES += "${LAYERDIR}/recipes-*/*/*.bb \
            ${LAYERDIR}/recipes-*/*/*.bbappend"

BBFILE_COLLECTIONS += "meta-layerindex-othertest"
BBFILE_PATTERN_meta-layerindex-othertest = "^${LAYERDIR}/"
BBFILE_PRIORITY_meta-layerindex-othertest = "6"

#LAYERDEPENDS_meta-layerindex-othertest = "core"
LAYERSERIES_COMPAT_meta-layerindex-othertest = "sumo"
```

## meta-layerindex-test/conf/layer.conf
```bitbake
# We have a conf and classes directory, add to BBPATH
BBPATH .= ":${LAYERDIR}"

# We have recipes-* directories, add to BBFILES
BBFILES += "${LAYERDIR}/recipes-*/*/*.bb \
            ${LAYERDIR}/recipes-*/*/*.bbappend"

BBFILE_COLLECTIONS += "meta-layerindex-test"
BBFILE_PATTERN_meta-layerindex-test = "^${LAYERDIR}/"
BBFILE_PRIORITY_meta-layerindex-test = "6"

#LAYERDEPENDS_meta-layerindex-test = "core"
LAYERSERIES_COMPAT_meta-layerindex-test = "sumo"
```
